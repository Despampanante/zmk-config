#include <behaviors.dtsi>
#include <behaviors/num_word.dtsi> // Requires auto-layer module.
#include <dt-bindings/zmk/keys.h>
// #ifdef CONFIG_WIRELESS
  #include <dt-bindings/zmk/bt.h>
  #include <dt-bindings/zmk/outputs.h>
  #define _BT_SEL_KEYS_                                                        \
      &bt BT_SEL 0 &bt BT_SEL 1 &bt BT_SEL 2 &bt BT_SEL 3 &bt BT_CLR
// #else
//   #define _BT_SEL_KEYS_ &trans &trans &trans &trans &trans
// #endif

#include "zmk-helpers/helper.h"
// #include "zmk-helpers/unicode-chars/greek.dtsi"
// #include "zmk-helpers/unicode-chars/german.dtsi"

#define DEF 0
#define DEF2 1
#define NAV 2
#define SYM 3
#define FN 4
#define NUM 5
#define SYS 6 
#define MOUSE 7
#define DEFs DEF DEF2

#define XXX &none
#define ___ &trans

/* Global defaults */

#define QUICK_TAP_MS 175

&sk {
  release-after-ms = <900>;
  quick-release;
};

&sl { // Allow sticky mods to chord across sticky layers.
  ignore-modifiers;
};

&lt {
  flavor = "balanced";
  tapping-term-ms = <200>;
  quick-tap-ms = <QUICK_TAP_MS>;
};

#ifndef ZMK_BASE_LAYER
  #define ZMK_BASE_LAYER(name, LT, RT, LM, RM, LB, RB, LH, RH)                 \
      ZMK_LAYER(name, LT RT LM RM LB RB LH RH)
#endif

#define COMBO_TERM_FAST 18
#define COMBO_TERM_SLOW 30
#define COMBO_IDLE_FAST 150
#define COMBO_IDLE_SLOW 50

/* Adjacent Key Combos */
ZMK_COMBO(m,      &kp M,           LMR LMM,     DEF, COMBO_TERM_FAST, COMBO_IDLE_FAST)
ZMK_COMBO(w,      &kp W,           LMP LMR,     DEF, COMBO_TERM_FAST, COMBO_IDLE_FAST)
ZMK_COMBO(f,      &kp F,           LBR LBM,     DEF, COMBO_TERM_FAST, COMBO_IDLE_FAST)
ZMK_COMBO(p,      &kp P,           LBM LBI,     DEF, COMBO_TERM_FAST, COMBO_IDLE_FAST)
ZMK_COMBO(k,      &kp K,           LMM LBI,     DEF, COMBO_TERM_FAST, COMBO_IDLE_FAST)
ZMK_COMBO(b,      &kp B,           LMI LMM,     DEF, COMBO_TERM_FAST, COMBO_IDLE_FAST)



ZMK_COMBO(j,      &kp J,           RMM RBI,     DEF, COMBO_TERM_FAST, COMBO_IDLE_FAST)
ZMK_COMBO(x,      &kp X,           RBI RBM,     DEF, COMBO_TERM_FAST, COMBO_IDLE_FAST)
ZMK_COMBO(v,      &kp V,           RMI RMM,     DEF, COMBO_TERM_FAST, COMBO_IDLE_FAST)
ZMK_COMBO(z,      &kp Z,           RBM RBR,     DEF, COMBO_TERM_FAST, COMBO_IDLE_FAST)
ZMK_COMBO(q,      &kp Q,           LMP RMP,     DEF, COMBO_TERM_FAST, COMBO_IDLE_FAST)

// Base layer with main keys
ZMK_BASE_LAYER(Base,
//╭─────────────┬─────────────┬─────────────┬─────────────┬─────────────╮ ╭─────────────┬─────────────┬─────────────┬─────────────┬─────────────╮
    ___           ___           ___           ___           ___         ,   ___           ___           ___           ___           ___         ,
//├─────────────┼─────────────┼─────────────┼─────────────┼─────────────┤ ├─────────────┼─────────────┼─────────────┼─────────────┼─────────────┤
    &kp R         &kp S         &kp T         &kp H         ___         ,   ___           &kp N         &kp A         &kp I         &kp O       ,
//├─────────────┼─────────────┼─────────────┼─────────────┼─────────────┤ ├─────────────┼─────────────┼─────────────┼─────────────┼─────────────┤
	___           &kp C         &kp G         &kp D         ___         ,   ___           &kp L         &kp U         &kp Y         ___         ,
//╰─────────────┼─────────────┴─────────────┼─────────────┼─────────────┤ ├─────────────┼─────────────┼─────────────┴───────────────────────────╯
                                              &kp BSPC      &kp E         , &kp SPACE     &kp TAB
//                                          ╰─────────────┴─────────────╯ ╰─────────────┴─────────────╯
)


/* vim: set ft=c tw=146: */