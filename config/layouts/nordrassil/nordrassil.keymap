#include <behaviors.dtsi>
#include <behaviors/num_word.dtsi> // Requires auto-layer module.
#include <dt-bindings/zmk/keys.h>
// #ifdef CONFIG_WIRELESS
  #include <dt-bindings/zmk/bt.h>
  #include <dt-bindings/zmk/outputs.h>
  #define _BT_SEL_KEYS_                                                        \
      &bt BT_SEL 0 &bt BT_SEL 1 &bt BT_SEL 2 &bt BT_SEL 3 &bt BT_CLR
// #else
//   #define _BT_SEL_KEYS_ &trans &trans &trans &trans &trans
// #endif

#include "zmk-helpers/helper.h"
// #include "zmk-helpers/unicode-chars/greek.dtsi"
// #include "zmk-helpers/unicode-chars/german.dtsi"

#define DEF 0
#define DEF2 1
#define NAV 2
#define SYM 3
#define FN 4
#define NUM 5
#define SYS 6 
#define MOUSE 7
#define DEFs DEF DEF2

#define XXX &none
#define ___ &trans

/* Global defaults */

#define QUICK_TAP_MS 175

&sk {
  release-after-ms = <900>;
  quick-release;
};

&sl { // Allow sticky mods to chord across sticky layers.
  ignore-modifiers;
};

&lt {
  flavor = "balanced";
  tapping-term-ms = <200>;
  quick-tap-ms = <QUICK_TAP_MS>;
};

/* Homerow mods */

// #define KEYS_L LT0 LT1 LT2 LT3 LT4 LM0 LM1 LM2 LM3 LM4 LB0 LB1 LB2 LB3 LB4
// #define KEYS_R RT0 RT1 RT2 RT3 RT4 RM0 RM1 RM2 RM3 RM4 RB0 RB1 RB2 RB3 RB4
// #ifndef LH2
//   #define THUMBS LH1 LH0 RH0 RH1         // Thumbs on 34 keys.
// #else
//   #define THUMBS LH2 LH1 LH0 RH0 RH1 RH2 // Thumbs on 36+ keys.
// #endif

// #define MAKE_HRM(NAME, HOLD, TAP, TRIGGER_POS)                                 \
//   ZMK_HOLD_TAP(NAME, bindings = <HOLD>, <TAP>; flavor = "balanced";            \
//                tapping-term-ms = <280>; quick-tap-ms = <QUICK_TAP_MS>;         \
//                require-prior-idle-ms = <150>; hold-trigger-on-release;         \
//                hold-trigger-key-positions = <TRIGGER_POS>;)

// MAKE_HRM(hml, &kp, &kp, KEYS_R THUMBS) // Left-hand HRMs.
// MAKE_HRM(hmr, &kp, &kp, KEYS_L THUMBS) // Right-hand HRMs.

// // Hack: Make HRM combos tap-only (cf, ZMK issue #544).
// #define ZMK_COMBO_8(NAME, TAP, POS, LAYERS, COMBO_MS, IDLE_MS, HOLD, SIDE)     \
//   MAKE_HRM(hm_combo_##NAME, &kp, TAP, SIDE THUMBS)                             \
//   ZMK_COMBO_6(NAME, &hm_combo_##NAME HOLD 0, POS, LAYERS, COMBO_MS, IDLE_MS)

/* Combos, leader key sequences, mouse emulation */

// #include "../../includes/combos.dtsi" // Must be sourced after HRM-combo hack.
// #include "../../includes/mouse.dtsi"

/* Nav cluster */

// Trigger tap-action on all interrupts.
#define MT_CORE                                                                \
  flavor = "tap-preferred";                                                    \
  tapping-term-ms = <220>;                                                     \
  quick-tap-ms = <220>;                                                        \
  hold-trigger-key-positions = <0>;

&mt { MT_CORE };

/* Magic-shift & auto-layers */

// Tap: repeat after alpha, else sticky-shift |
// Shift + tap/ double-tap: caps-word | Hold: shift.
#define MAGIC_SHIFT &magic_shift LSHFT 0
ZMK_HOLD_TAP(magic_shift, bindings = <&kp>, <&magic_shift_tap>;
             flavor = "balanced"; tapping-term-ms = <200>;
             quick-tap-ms = <QUICK_TAP_MS>;)
ZMK_MOD_MORPH(magic_shift_tap, bindings = <&shift_repeat>, <&caps_word>;
              mods = <(MOD_LSFT)>;)
ZMK_ADAPTIVE_KEY(
    shift_repeat, bindings = <&sk LSHFT>;
    repeat {
      trigger-keys = <A B C D E F G H I J K L M N O P Q R S T U V W X Y Z>;
      bindings = <&key_repeat>;
      max-prior-idle-ms = <1200>;
      strict-modifiers;
    };)
&caps_word { // Mods deactivate caps-word, requires PR #1451. [TODO: rebase]
  /delete-property/ ignore-modifiers;
};

// Tap: num-word | double-tap: sticky num-layer | Hold: num-layer.
#define SMART_NUM &smart_num NUM 0
ZMK_HOLD_TAP(smart_num, bindings = <&mo>, <&num_dance>; flavor = "balanced";
             tapping-term-ms = <200>; quick-tap-ms = <QUICK_TAP_MS>;)
ZMK_TAP_DANCE(num_dance, bindings = <&num_word NUM>, <&sl NUM>;
              tapping-term-ms = <200>;)

/* Custom behaviors */

// // Alt+Tab swapper, requires tri-state module.
// ZMK_TRI_STATE(swapper, bindings = <&kt LALT>, <&kp TAB>, <&kt LALT>;
//               ignored-key-positions = <LT2 RT2 RM1 RM2 RM3>;)

// Define mod-morph with a *single* mod trigger for less repetition.
#define SIMPLE_MORPH(NAME, MOD, BINDING1, BINDING2)                            \
  ZMK_MOD_MORPH(NAME, mods = <(MOD_L##MOD | MOD_R##MOD)>;                      \
                bindings = <BINDING1>, <BINDING2>;)

// Tap: comma | Shift + tap: semicolon | Ctrl + shift + tap: <.
SIMPLE_MORPH(comma_morph, SFT, &kp COMMA, &comma_inner_morph)
SIMPLE_MORPH(comma_inner_morph, CTL, &kp SEMICOLON, &kp LESS_THAN)

// Tap: dot | Shift + tap: colon | Ctrl + shift + tap: >.
SIMPLE_MORPH(dot_morph, SFT, &kp DOT, &dot_inner_morph)
SIMPLE_MORPH(dot_inner_morph, CTL, &kp COLON, &kp GREATER_THAN)

// Tap: qmark | Shift + tap: excl.
SIMPLE_MORPH(qexcl, SFT, &kp QMARK, &kp EXCL)

// Tap: left/right parenthesis | Shft + tap: less-than/greater-than.
SIMPLE_MORPH(lpar_lt, SFT, &kp LPAR, &kp LT)
SIMPLE_MORPH(rpar_gt, SFT, &kp RPAR, &kp GT)

// Tap: space | Shift + tap: dot -> space -> sticky shift | Hold: nav layer.
ZMK_HOLD_TAP(lt_spc, bindings = <&mo>, <&spc_morph>; flavor = "balanced";
             tapping-term-ms = <200>; quick-tap-ms = <QUICK_TAP_MS>;)
SIMPLE_MORPH(spc_morph, SFT, &kp SPACE, &dot_spc)
ZMK_MACRO(dot_spc, bindings = <&kp DOT &kp SPACE &sk LSHFT>; wait-ms = <0>;
          tap-ms = <5>;)

// Tap: backspace | Lshft + tap: delete | Rshft + tap: shift-delete.
ZMK_MOD_MORPH(bs_del, bindings = <&kp BSPC>, <&kp DEL>;
              mods = <(MOD_LSFT|MOD_RSFT)>; keep-mods = <MOD_RSFT>;)

// Tap: copy | double-tap: cut.
ZMK_TAP_DANCE(copy_cut, bindings = <&kp LC(INS)>, <&kp LC(X)>;
              tapping-term-ms = <200>;)

// // Sticky shift + leader.
// ZMK_MACRO(leader_sft, bindings = <&sk LSHFT &leader>;)

// Misc aliases. [TODO: clean up]
#define CANCEL    &kp K_CANCEL            // Cancel caps-word & auto-layers.
#define DSK_PREV  &hmr LCTRL LG(LC(LEFT)) // Previous desktop.
#define DSK_NEXT  &hmr LALT LG(LC(RIGHT)) // Next     desktop.
#define PIN_WIN   &kp LG(LC(LS(Q)))       // Pin window across desktops.
#define PIN_APP   &kp LG(LC(LS(A)))       // Pin application across desktops.
#define DSK_MGR   &kp LA(GRAVE)           // Desktop manager.
#define VOL_DOWN  &hmr RSHFT C_VOL_DN

/* Keymap */

ZMK_CONDITIONAL_LAYER(sys, FN NUM, SYS) // FN + NUM --> SYS.

#ifndef ZMK_BASE_LAYER
  #define ZMK_BASE_LAYER(name, LT, RT, LM, RM, LB, RB, LH, RH)                 \
      ZMK_LAYER(name, LT RT LM RM LB RB LH RH)
#endif

 / {
    behaviors {
        magicR: magicR {
            compatible = "zmk,behavior-adaptive-key";
            #binding-cells = <0>;
            bindings = <&key_repeat>;
            
            // Left-hand magic expansions (no repeats - removed rules that output same letter)
			r_a_space { trigger-keys = <A>; max-prior-idle-ms = <300>; bindings = <&kp SPACE>; };
            r_b_ecause { trigger-keys = <B>; max-prior-idle-ms = <300>; bindings = <&kp E &kp C &kp A &kp U &kp S &kp E>; };
            r_c_an { trigger-keys = <C>; max-prior-idle-ms = <300>; bindings = <&kp A &kp N>; };
            r_g_eneral { trigger-keys = <G>; max-prior-idle-ms = <300>; bindings = <&kp E &kp N &kp E &kp R &kp A &kp L>; };
            r_j_ust { trigger-keys = <J>; max-prior-idle-ms = <300>; bindings = <&kp U &kp S &kp T>; };
            r_m_ent { trigger-keys = <M>; max-prior-idle-ms = <300>; bindings = <&kp E &kp N &kp T>; };
            r_n_ion { trigger-keys = <N>; max-prior-idle-ms = <300>; bindings = <&kp I &kp O &kp N>; };
            r_p_retty { trigger-keys = <P>; max-prior-idle-ms = <300>; bindings = <&kp R &kp E &kp T &kp T &kp Y>; };
            r_v_azjorfia { trigger-keys = <V>; max-prior-idle-ms = <300>; bindings = <&kp A &kp Z &kp J &kp O &kp R &kp F &kp I &kp A>; };
            r_w_hich { trigger-keys = <W>; max-prior-idle-ms = <300>; bindings = <&kp H &kp I &kp C &kp H>; };
            r_comm_and { trigger-keys = <COMMA>; max-prior-idle-ms = <300>; bindings = <&kp SPACE &kp A &kp N &kp D>; };
        };

		magicL: magicL {
            compatible = "zmk,behavior-adaptive-key";
            #binding-cells = <0>;
            bindings = <&key_repeat>;
            
            // Right-hand magic expansions (no repeats - removed rules that output same letter)
            l_a_nd { trigger-keys = <A>; max-prior-idle-ms = <300>; bindings = <&kp N &kp D &kp SPACE>; };
            l_i_on { trigger-keys = <I>; max-prior-idle-ms = <300>; bindings = <&kp O &kp N>; };
            l_q_ueen { trigger-keys = <Q>; max-prior-idle-ms = <300>; bindings = <&kp U &kp E &kp E &kp N>; };
            l_x_ex { trigger-keys = <X>; max-prior-idle-ms = <300>; bindings = <&kp E &kp X>; };
            l_y_eah { trigger-keys = <Y>; max-prior-idle-ms = <300>; bindings = <&kp E &kp A &kp H>; };
            l_comm_but { trigger-keys = <COMMA>; max-prior-idle-ms = <300>; bindings = <&kp SPACE &kp B &kp U &kp T>; };
            l_spc_the { trigger-keys = <SPACE>; max-prior-idle-ms = <300>; bindings = <&kp T &kp H &kp E>; };
			//"*N**or**dr**as**s**i**l**"
			r_astr_nordrassil { trigger-keys = <ASTERISK>; max-prior-idle-ms = <300>; bindings = <&kp N &kp O &kp R &kp D &kp R &kp A &kp S &kp S &kp I &kp L>; };
        };

		magicR2: magicR2 {
            compatible = "zmk,behavior-adaptive-key";
            #binding-cells = <0>;
            bindings = <&key_repeat>;
            
            // Left-hand magic expansions (no repeats - removed rules that output same letter)
			r_r_l { trigger-keys = <R>; max-prior-idle-ms = <300>; bindings = <&kp L>; };
			r_w_n { trigger-keys = <W>; max-prior-idle-ms = <300>; bindings = <&kp N>;};
			r_e_o { trigger-keys = <E>; max-prior-idle-ms = <300>; bindings = <&kp O>;};
			r_s_c { trigger-keys = <S>; max-prior-idle-ms = <300>; bindings = <&kp C>; };
        };

    };
 };
#define COMBO_TERM_FAST 18
#define COMBO_TERM_SLOW 30

#define COMBO_IDLE_FAST 150
#define COMBO_IDLE_SLOW 50
ZMK_COMBO(lTab, 		 &kp TAB,           LMR LMM,     DEFs, COMBO_TERM_FAST, COMBO_IDLE_FAST)
ZMK_COMBO(rBSPC, 		 &kp BSPC,           RMI RMM,     DEFs, COMBO_TERM_FAST, COMBO_IDLE_FAST)




// ═══════════════════════════════════════════════════════════════════════════
// 𖣂 NORDRASSIL (rejuvenated)
// ═══════════════════════════════════════════════════════════════════════════
//
// DEF Layer (Primary):
//   _  C  L  D  _  │  _  U  O  Y  _
//   N  S  R  T  _  │  _  A  E  I  H
//   _  G  K  M  _  │  _ R*  ,  M  _
//         T SL2 │ SPC SL2
//
// DEF2 Layer (Secondary):
//   _  B  K  Q  _  │  _  _  _  _  _
//   W  P  V  D  _  │  _  _  _  _  _
//   _  F  X  Z  _  │  _  _  _  _  _
//         _  _ │ _  _
//
// Notes: R* = magicR2 (adaptive key)
// ═══════════════════════════════════════════════════════════════════════════

// DEF Layer (Detailed):
//   _  C  L  D  _    _  U  O  Y  _
//   N  S  R  T  _    _  A  E  I  H
//   _  G  K  M  _    _  *  ,  '  _
//         _ SL2     SPC _
//
// DEF2 Layer (Detailed):
//   _  B  _  Q  _    _  _  _  _  _
//   W  P  V  _  _    _  _  _  _  _
//   _  F  X  Z  _    _  _  _  _  _ 
//         _  _     _  _

// ZMK_BASE_LAYER(DEF,
// //╭─────────────┬─────────────┬─────────────┬─────────────┬─────────────╮ ╭─────────────┬─────────────┬─────────────┬─────────────┬─────────────╮
//   ___           &kp W         &kp N         &kp C         ___         ,   ___           &kp U         &kp O         &kp Y         ___       ,
// //├─────────────┼─────────────┼─────────────┼─────────────┼─────────────┤ ├─────────────┼─────────────┼─────────────┼─────────────┼─────────────┤
//   &kp T         &kp S         &kp R         &kp D         ___         ,   ___           &kp A         &kp E         &kp I         &kp H       ,
// //├─────────────┼─────────────┼─────────────┼─────────────┼─────────────┤ ├─────────────┼─────────────┼─────────────┼─────────────┼─────────────┤
//   ___           &kp F         &kp L         &magicL           ___         ,   ___       &magicR           &kp COMMA     &kp SQT       ___       ,
// //╰─────────────┼─────────────┴─────────────┼─────────────┼─────────────┤ ├─────────────┼─────────────┼─────────────┴───────────────────────────╯
//                                                &kp T     &sl DEF2       ,   &kp SPACE    &sl DEF2
// //                                          ╰─────────────┴─────────────╯ ╰─────────────┴─────────────╯
// )

// ZMK_BASE_LAYER(DEF2,
// //╭─────────────┬─────────────┬─────────────┬─────────────┬─────────────╮ ╭─────────────┬─────────────┬─────────────┬─────────────┬─────────────╮
//   ___           &kp K         &kp Q         &kp G         ___         ,   ___           ___           ___           ___           ___       ,
// //├─────────────┼─────────────┼─────────────┼─────────────┼─────────────┤ ├─────────────┼─────────────┼─────────────┼─────────────┼─────────────┤
//   &kp P           &kp M         &kp V         &kp J         ___         ,   ___           ___           ___           ___           ___       ,
// //├─────────────┼─────────────┼─────────────┼─────────────┼─────────────┤ ├─────────────┼─────────────┼─────────────┼─────────────┼─────────────┤
//   ___           &kp B         &kp L         &kp Z         ___         ,   ___           ___           ___           ___           ___       ,
// //╰─────────────┼─────────────┴─────────────┼─────────────┼─────────────┤ ├─────────────┼─────────────┼─────────────┴───────────────────────────╯
//                                                ___           ___      ,   ___    ___
// //                                          ╰─────────────┴─────────────╯ ╰─────────────┴─────────────╯
// )



ZMK_BASE_LAYER(DEF,
//╭─────────────┬─────────────┬─────────────┬─────────────┬─────────────╮ ╭─────────────┬─────────────┬─────────────┬─────────────┬─────────────╮
  ___           &kp C         &kp L         &kp D         ___         ,   ___           &kp U         &kp O         &kp Y         ___       ,
//├─────────────┼─────────────┼─────────────┼─────────────┼─────────────┤ ├─────────────┼─────────────┼─────────────┼─────────────┼─────────────┤
  &kp N	        &kp S         &kp R         &kp T         ___         ,   ___           &kp A         &kp E         &kp I         &kp H       ,
//├─────────────┼─────────────┼─────────────┼─────────────┼─────────────┤ ├─────────────┼─────────────┼─────────────┼─────────────┼─────────────┤
  ___           &kp G         &kp K        &kp M           ___            ,   ___       &magicR2           &kp COMMA     &kp M       ___       ,
//╰─────────────┼─────────────┴─────────────┼─────────────┼─────────────┤ ├─────────────┼─────────────┼─────────────┴───────────────────────────╯
                                               ___       &sl DEF2       ,   &kp SPACE    &sl DEF2
//                                          ╰─────────────┴─────────────╯ ╰─────────────┴─────────────╯
)

ZMK_BASE_LAYER(DEF2,
//╭─────────────┬─────────────┬─────────────┬─────────────┬─────────────╮ ╭─────────────┬─────────────┬─────────────┬─────────────┬─────────────╮
  ___             &kp B         &kp J         &kp Q         ___         ,   ___           ___           ___           ___           ___       ,
//├─────────────┼─────────────┼─────────────┼─────────────┼─────────────┤ ├─────────────┼─────────────┼─────────────┼─────────────┼─────────────┤
  &kp W           &kp P         &kp V         ___         ___         ,   ___           ___           ___           ___           ___       ,
//├─────────────┼─────────────┼─────────────┼─────────────┼─────────────┤ ├─────────────┼─────────────┼─────────────┼─────────────┼─────────────┤
  ___             &kp F         &kp X         &kp Z         ___         ,   ___           ___           ___           ___           ___       ,
//╰─────────────┼─────────────┴─────────────┼─────────────┼─────────────┤ ├─────────────┼─────────────┼─────────────┴───────────────────────────╯
                                               ___           ___      ,   ___    ___
//                                          ╰─────────────┴─────────────╯ ╰─────────────┴─────────────╯
)

