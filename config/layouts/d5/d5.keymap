#include <behaviors.dtsi>
#include <behaviors/num_word.dtsi> // Requires auto-layer module.
#include <dt-bindings/zmk/keys.h>
#ifdef CONFIG_WIRELESS
  #include <dt-bindings/zmk/bt.h>
  #include <dt-bindings/zmk/outputs.h>
  #define _BT_SEL_KEYS_                                                        \
      &bt BT_SEL 0 &bt BT_SEL 1 &bt BT_SEL 2 &bt BT_SEL 3 &bt BT_CLR
#else
  #define _BT_SEL_KEYS_ &trans &trans &trans &trans &trans
#endif

#include "zmk-helpers/helper.h"


#define DEF 0
#define NAV  1
#define NUM  2
#define SYS  3

#define XXX &none
#define ___ &trans

#ifndef ZMK_BASE_LAYER
  #define ZMK_BASE_LAYER(name, LT, RT, LM, RM, LB, RB, LH, RH)                 \
      ZMK_LAYER(name, LT RT LM RM LB RB LH RH)
#endif

#include "zmk-helpers/helper.h"
#define COMBO_TERM_FAST 18
#define COMBO_TERM_SLOW 30

#define COMBO_IDLE_FAST 150
#define COMBO_IDLE_SLOW 50
#define XXX &none
#define ___ &trans

/ {
  macros {
    // Two parameters: layer and keycode
    db: db {
      compatible = "zmk,behavior-macro-two-param";
      #binding-cells = <2>;
	  wait-ms = <30>;
      tap-ms = <40>;
      bindings = <
        &macro_param_1to1 &kp MACRO_PLACEHOLDER  // Use first parameter (layer) for momentary activation
        &macro_param_2to1 &kp MACRO_PLACEHOLDER // Use second parameter (keycode) for tap
      >;
    };
  };
};

ZMK_COMBO(eg,  &db E G,     LTR LMR,     DEF, COMBO_TERM_FAST, COMBO_IDLE_FAST)
ZMK_COMBO(ew,  &db E W,     LMR LBR,     DEF, COMBO_TERM_FAST, COMBO_IDLE_FAST)
ZMK_COMBO(ct,  &db C T,     LTM LMM,     DEF, COMBO_TERM_FAST, COMBO_IDLE_FAST)
ZMK_COMBO(tc,  &db T C,     LMM LBM,     DEF, COMBO_TERM_FAST, COMBO_IDLE_FAST)
ZMK_COMBO(rm,  &db R M,     LTI LMI,     DEF, COMBO_TERM_FAST, COMBO_IDLE_FAST)
ZMK_COMBO(rk,  &db R K,     LMI LBI,     DEF, COMBO_TERM_FAST, COMBO_IDLE_FAST)
ZMK_COMBO(yv,  &kp X  ,     LTC LMC,     DEF, COMBO_TERM_FAST, COMBO_IDLE_FAST)

ZMK_COMBO(je,  &db J E,     RTR RMR,     DEF, COMBO_TERM_FAST, COMBO_IDLE_FAST)
ZMK_COMBO(es,  &db E S,     RMR RBR,     DEF, COMBO_TERM_FAST, COMBO_IDLE_FAST)
ZMK_COMBO(nf,  &db N F,     RTM RMM,     DEF, COMBO_TERM_FAST, COMBO_IDLE_FAST)
ZMK_COMBO(np,  &db N P,     RMM RBM,     DEF, COMBO_TERM_FAST, COMBO_IDLE_FAST)
ZMK_COMBO(bl,  &db B L,     RTI RMI,     DEF, COMBO_TERM_FAST, COMBO_IDLE_FAST)
ZMK_COMBO(hl,  &db H L,     RMI RBI,     DEF, COMBO_TERM_FAST, COMBO_IDLE_FAST)
ZMK_COMBO(q ,  &kp Q  ,     RTC RMC,     DEF, COMBO_TERM_FAST, COMBO_IDLE_FAST)
 
ZMK_COMBO(ui,  &db U I,     LHI LHO,     DEF, COMBO_TERM_FAST, COMBO_IDLE_FAST)
ZMK_COMBO(oa,  &db O A,     RHI RHO,     DEF, COMBO_TERM_FAST, COMBO_IDLE_FAST)
 
ZMK_COMBO(o,   &kp O   ,    LMR LMM,     DEF, COMBO_TERM_FAST, COMBO_IDLE_FAST)
ZMK_COMBO(a,   &kp A   ,    LMM LMI,     DEF, COMBO_TERM_FAST, COMBO_IDLE_FAST)
  
ZMK_COMBO(u,   &kp U   ,    RMR RMM,     DEF, COMBO_TERM_FAST, COMBO_IDLE_FAST)
ZMK_COMBO(i,   &kp I   ,    RMM RMI,     DEF, COMBO_TERM_FAST, COMBO_IDLE_FAST)

 / {
    behaviors {
        r_rep_space: r_rep_space {
            compatible = "zmk,behavior-adaptive-key";
            #binding-cells = <0>;
            bindings = <&kp SPACE>;

            thing { trigger-keys = <B F J Z L N H P S>; max-prior-idle-ms = <300>; bindings = <&key_repeat>; };
            

        };
		l_rep_space: l_rep_space {
            compatible = "zmk,behavior-adaptive-key";
            #binding-cells = <0>;
            bindings = <&kp SPACE>;

            thing { trigger-keys = <G D M T R V W C K>; max-prior-idle-ms = <300>; bindings = <&key_repeat>; }; 

        };
    };
 };

ZMK_BASE_LAYER(DEF,
//╭─────────────┬─────────────┬─────────────┬─────────────┬─────────────╮ ╭─────────────┬─────────────┬─────────────┬─────────────┬─────────────╮
    ___           &kp G         &kp D         &kp M         &kp Y       ,   &kp Y        &kp B         &kp F         &kp J         ___          ,
//├─────────────┼─────────────┼─────────────┼─────────────┼─────────────┤ ├─────────────┼─────────────┼─────────────┼─────────────┼─────────────┤
    &l_rep_space  &kp E         &kp T         &kp R         &kp V       ,   &kp Z        &kp L         &kp N         &kp E         &r_rep_space      ,
//├─────────────┼─────────────┼─────────────┼─────────────┼─────────────┤ ├─────────────┼─────────────┼─────────────┼─────────────┼─────────────┤
    &kp TAB       &kp W         &kp C         &kp K         &kp BSPC    ,   &kp BSPC     &kp H         &kp P         &kp S         &kp ENTER    ,
//╰─────────────┼─────────────┴─────────────┼─────────────┼─────────────┤ ├─────────────┼─────────────┼─────────────┴───────────────────────────╯
                                              &kp U         &kp I       ,   &kp A    &kp O
//                                          ╰─────────────┴─────────────╯ ╰─────────────┴─────────────╯
)



/* vim: set ft=c tw=146: */