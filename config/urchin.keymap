#include "keypos_def/keypos_34keys.h"
// #include "includes/yeah_base.keymap"
// #include "layouts/buggy/buggy_base.keymap"
// #include "layouts/night/night_flipped.keymap"
// #include "layouts/whirl/whirl.keymap"
// #include "layouts/engrammer/engrammer.keymap"
// #include "layouts/reafael/romao.keymap"
// #include "layouts/nordrassil/nordrassil.keymap"
// #include "layouts/d5/d5.keymap"
// #include "layouts/TEST/test.keymap"
#include "newStruc/test_all.keymap"
// #include "layouts/yeah/yeah.keymap"
// #include "layouts/chog/chog.keymap"
// #include "layouts/reeve/reeve.keymap"
// #include "layouts/wormy/wormy.keymap"
// #include "layouts/magicStronk/magicStronk.keymap"
// #include "layouts/night4col/night4col.keymap"
// #include "layouts/teenspirit/teenspirit.keymap"
// #include "includes/base.keymap"
// #include "includes/just_alphas.keymap"