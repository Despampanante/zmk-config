#include <behaviors.dtsi>
#include <behaviors/num_word.dtsi> // Requires auto-layer module.
#include <dt-bindings/zmk/keys.h>
#ifdef CONFIG_WIRELESS
  #include <dt-bindings/zmk/bt.h>
  #include <dt-bindings/zmk/outputs.h>
  #define _BT_SEL_KEYS_                                                        \
      &bt BT_SEL 0 &bt BT_SEL 1 &bt BT_SEL 2 &bt BT_SEL 3 &bt BT_CLR
#else
  #define _BT_SEL_KEYS_ &trans &trans &trans &trans &trans
#endif

#include "zmk-helpers/helper.h"
// #include "zmk-helpers/unicode-chars/greek.dtsi"
// #include "zmk-helpers/unicode-chars/german.dtsi"

#define DEF 0
#define NAV 1
#define FN 2
#define NUM 3
#define SYS 4
#define MOUSE 5

#define XXX &none
#define ___ &trans

#ifndef ZMK_BASE_LAYER
  #define ZMK_BASE_LAYER(name, LT, RT, LM, RM, LB, RB, LH, RH)                 \
      ZMK_LAYER(name, LT RT LM RM LB RB LH RH)
#endif

// ZMK_BASE_LAYER(Base,
// //╭─────────────┬─────────────┬─────────────┬─────────────┬─────────────╮ ╭─────────────┬─────────────┬─────────────┬─────────────┬─────────────╮
//     &kp B         &kp F         &kp L         &kp K         &kp Q       ,   &kp P         &kp G         &kp O         &kp U         &kp DOT     ,
// //├─────────────┼─────────────┼─────────────┼─────────────┼─────────────┤ ├─────────────┼─────────────┼─────────────┼─────────────┼─────────────┤
//     &kp N         &kp S         &kp H         &kp T         &kp M   ,       &kp Y         &kp C         &kp A         &kp E         &kp I ,
// //├─────────────┼─────────────┼─────────────┼─────────────┼─────────────┤ ├─────────────┼─────────────┼─────────────┼─────────────┼─────────────┤
//     &kp X         &kp V         &kp J         &kp D         &kp Z       ,   &kp SQT       &kp W         &kp SEMI      &kp SLASH    &kp COMMA    ,
// //╰─────────────┼─────────────┴─────────────┼─────────────┼─────────────┤ ├─────────────┼─────────────┼─────────────┴───────────────────────────╯
//                                               &kp BSPC      &kp R       ,   &kp SPACE     &kp TAB
// //                                          ╰─────────────┴─────────────╯ ╰─────────────┴─────────────╯
// )


//whirl (lenchog) (6 likes)
// q g d f v  z l u o y
// n s t h m  ' r e a i
// b c p w k  x j ; . ,
//              *  
//Magic rules: wh gs ue y, 
//aa bb cc dd ee ff hh ii jj ll mm nn oo pp qq rr ss tt vv xx zz
//  / {
//     behaviors {
//         ak_magic: ak_magic {
//             compatible = "zmk,behavior-adaptive-key";
//             #binding-cells = <0>;
//             bindings = <&key_repeat>;

//             akt_WM { trigger-keys = <W>; max-prior-idle-ms = <300>; bindings = <&kp H>; };
//             akt_GM { trigger-keys = <G>; max-prior-idle-ms = <300>; bindings = <&kp S>; };
//             akt_UM { trigger-keys = <U>; max-prior-idle-ms = <300>; bindings = <&kp E>; };
//             akt_YM { trigger-keys = <Y>; max-prior-idle-ms = <300>; bindings = <&kp COMMA>; };

//         };
//     };
//  };

// ZMK_BASE_LAYER(Base,
// //╭─────────────┬─────────────┬─────────────┬─────────────┬─────────────╮ ╭─────────────┬─────────────┬─────────────┬─────────────┬─────────────╮
//     &kp Q         &kp G         &kp D         &kp F         &kp V       ,   &kp Z         &kp L         &kp U         &kp O         &kp Y       ,
// //├─────────────┼─────────────┼─────────────┼─────────────┼─────────────┤ ├─────────────┼─────────────┼─────────────┼─────────────┼─────────────┤
//     &kp N         &kp S         &kp T         &kp H         &kp M       ,   &kp SQT       &kp R         &kp E         &kp A         &kp I       ,
// //├─────────────┼─────────────┼─────────────┼─────────────┼─────────────┤ ├─────────────┼─────────────┼─────────────┼─────────────┼─────────────┤
//     &kp B         &kp C         &kp P         &kp W         &kp K       ,   &kp X         &kp J         &kp SEMI      &kp DOT       &kp COMMA   ,
// //╰─────────────┼─────────────┴─────────────┼─────────────┼─────────────┤ ├─────────────┼─────────────┼─────────────┴───────────────────────────╯
//                                               &kp BSPC      &kp SPACE   ,   &ak_magic     &kp TAB
// //                                          ╰─────────────┴─────────────╯ ╰─────────────┴─────────────╯
// )

// koi (zak.7) (3 likes)
//   v l t w x  f k o i b
//   r m c s g  p h a u n
//   z ; , * q  ' d . y j
//           e    
// Magic rules: ct yo by er ll no ff tt oo ui jo dd
// an* -> any (or a*-any)
// ab* -> abo or abo* -> abou (or ab* -> about)
// io* -> ion* (or i* -> ion) 

//  / {
//     behaviors {
//         ak_magic2: ak_magic2 {
//             compatible = "zmk,behavior-adaptive-key";
//             #binding-cells = <0>;
//             bindings = <&key_repeat>;

//             akt_CT{ trigger-keys = <W>; max-prior-idle-ms = <300>; bindings = <&kp H>; };
//             akt_YO { trigger-keys = <G>; max-prior-idle-ms = <300>; bindings = <&kp S>; };
//             akt_BY { trigger-keys = <U>; max-prior-idle-ms = <300>; bindings = <&kp E>; };
//             akt_ER { trigger-keys = <Y>; max-prior-idle-ms = <300>; bindings = <&kp COMMA>; };b
//             akt_NO { trigger-keys = <Y>; max-prior-idle-ms = <300>; bindings = <&kp COMMA>; };
//             akt_UI { trigger-keys = <Y>; max-prior-idle-ms = <300>; bindings = <&kp COMMA>; };
//             akt_JO { trigger-keys = <Y>; max-prior-idle-ms = <300>; bindings = <&kp COMMA>; };


//         };
//         ak_magic3: ak_magic3 {
//             compatible = "zmk,behavior-adaptive-key";
//             #binding-cells = <0>;
//             bindings = <&key_repeat>;

            
//         };
//     };
//  };
// ZMK_BASE_LAYER(Base,
// //╭─────────────┬─────────────┬─────────────┬─────────────┬─────────────╮ ╭─────────────┬─────────────┬─────────────┬─────────────┬─────────────╮
//     &kp V         &kp L         &kp T         &kp W         &kp X       ,   &kp F         &kp K         &kp O         &kp I         &kp B       ,
// //├─────────────┼─────────────┼─────────────┼─────────────┼─────────────┤ ├─────────────┼─────────────┼─────────────┼─────────────┼─────────────┤
//     &kp R         &kp M         &kp C         &kp S         &kp G       ,   &kp P         &kp H         &kp A         &kp U         &kp N       ,
// //├─────────────┼─────────────┼─────────────┼─────────────┼─────────────┤ ├─────────────┼─────────────┼─────────────┼─────────────┼─────────────┤
//     &kp Z         &kp SEMI      &kp COMMA     &ak_magic2    &kp Q       ,   &kp SQT       &kp D         &kp DOT       &kp Y         &kp J       ,
// //╰─────────────┼─────────────┴─────────────┼─────────────┼─────────────┤ ├─────────────┼─────────────┼─────────────┴───────────────────────────╯
//                                               &kp BSPC      &kp E       ,   &kp SPACE    &kp TAB
// //                                          ╰─────────────┴─────────────╯ ╰─────────────┴─────────────╯
// )
ZMK_BASE_LAYER(Base,
//╭─────────────┬─────────────┬─────────────┬─────────────┬─────────────╮ ╭─────────────┬─────────────┬─────────────┬─────────────┬─────────────╮
    &kp Q         &kp W         &kp E         &kp R         &kp T       ,   &kp Y         &kp U         &kp I         &kp O         &kp P       ,
//├─────────────┼─────────────┼─────────────┼─────────────┼─────────────┤ ├─────────────┼─────────────┼─────────────┼─────────────┼─────────────┤
    &kp A         &kp S         &kp D         &kp F         &kp G       ,   &kp H         &kp J         &kp K         &kp L         &kp SEMI    ,
//├─────────────┼─────────────┼─────────────┼─────────────┼─────────────┤ ├─────────────┼─────────────┼─────────────┼─────────────┼─────────────┤
    &kp Z         &kp X         &kp C         &kp V         &kp B       ,   &kp N         &kp M         &kp COMMA     &kp DOT       &kp SLASH   ,
//╰─────────────┼─────────────┴─────────────┼─────────────┼─────────────┤ ├─────────────┼─────────────┼─────────────┴───────────────────────────╯
                                              &kp BSPC      &kp BSPC    ,   &kp SPACE     &kp ENTER
//                                          ╰─────────────┴─────────────╯ ╰─────────────┴─────────────╯
)
